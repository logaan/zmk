## app/boards/logaan/blank_slate/Kconfig.blank_slate
```kconfig
# SPDX-License-Identifier: MIT

config BOARD_BLANK_SLATE
    select SOC_NRF52840_QIAA
    select ZMK_BOARD_COMPAT if BOARD_BLANK_SLATE_NRF52840_ZMK
    imply RETAINED_MEM if BOARD_BLANK_SLATE_NRF52840_ZMK
    imply RETENTION if BOARD_BLANK_SLATE_NRF52840_ZMK
    imply RETENTION_BOOT_MODE if BOARD_BLANK_SLATE_NRF52840_ZMK
```

## app/boards/logaan/blank_slate/Kconfig.defconfig
```kconfig
# Copyright (c) 2020 Pete Johanson
# SPDX-License-Identifier: MIT

if BOARD_BLANK_SLATE

config ZMK_KEYBOARD_NAME
    default "Blank Slate"

endif # BOARD_BLANK_SLATE
```

## app/boards/logaan/blank_slate/blank_slate_nrf52840_zmk_defconfig
```kconfig
# SPDX-License-Identifier: MIT

CONFIG_ARM_MPU=y
CONFIG_GPIO=y
CONFIG_PINCTRL=y

# Adafruit nRF52 UF2 bootloader.
CONFIG_USE_DT_CODE_PARTITION=y
CONFIG_BUILD_OUTPUT_UF2=y

# Persistent Bluetooth settings and ZMK Studio keymaps.
CONFIG_MPU_ALLOW_FLASH_WRITE=y
CONFIG_NVS=y
CONFIG_SETTINGS_NVS=y
CONFIG_FLASH=y
CONFIG_FLASH_PAGE_LAYOUT=y
CONFIG_FLASH_MAP=y

CONFIG_ZMK_USB=y
CONFIG_ZMK_BLE=y
CONFIG_ZMK_SLEEP=y
CONFIG_ZMK_PM_SOFT_OFF=y
```

## app/boards/logaan/blank_slate/board.yml
```yaml
board:
  name: blank_slate
  full_name: Blank Slate
  vendor: logaan
  socs:
    - name: nrf52840
      variants:
        - name: zmk
```
